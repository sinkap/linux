## drivers/dma-buf/heaps/Kconfig
```kconfig
config DMABUF_HEAPS_SYSTEM
	bool "DMA-BUF System Heap"
	depends on DMABUF_HEAPS
	help
	  Choose this option to enable the system dmabuf heap. The system heap
	  is backed by pages from the buddy allocator. If in doubt, say Y.

config DMABUF_HEAPS_CMA
	bool "DMA-BUF CMA Heap"
	depends on DMABUF_HEAPS && DMA_CMA
	help
	  Choose this option to enable dma-buf CMA heap. This heap is backed
	  by the Contiguous Memory Allocator (CMA). If your system has these
	  regions, you should say Y here.

config DMABUF_HEAPS_CARVEOUT
	bool "DMA-BUF Carveout Heap"
	depends on DMABUF_HEAPS && OF_RESERVED_MEM
	select GENERIC_ALLOCATOR
	help
	  Choose this option to enable the dma-buf carveout heap. It exposes an
	  exclusively reserved memory region (a /reserved-memory node marked
	  with an "export" property, neither reusable nor no-map) as its own
	  dma-heap. Unlike CMA, the region is kept out of the page allocator,
	  so allocations do not fail with -EBUSY under memory pressure. If in
	  doubt, say N.
```

## kernel/bpf/Kconfig
```kconfig
# SPDX-License-Identifier: GPL-2.0-only

# BPF interpreter that, for example, classic socket filters depend on.
config BPF
	bool
	select CRYPTO_LIB_SHA256

# Used by archs to tell that they support BPF JIT compiler plus which
# flavour. Only one of the two can be selected for a specific arch since
# eBPF JIT supersedes the cBPF JIT.

# Classic BPF JIT (cBPF)
config HAVE_CBPF_JIT
	bool

# Extended BPF JIT (eBPF)
config HAVE_EBPF_JIT
	bool

# Used by archs to tell that they want the BPF JIT compiler enabled by
# default for kernels that were compiled with BPF JIT support.
config ARCH_WANT_DEFAULT_BPF_JIT
	bool

menu "BPF subsystem"

config BPF_SYSCALL
	bool "Enable bpf() system call"
	select BPF
	select IRQ_WORK
	select NEED_TASKS_RCU
	select TASKS_TRACE_RCU
	select BINARY_PRINTF
	select NET_SOCK_MSG if NET
	select NET_XGRESS if NET
	select PAGE_POOL if NET
	default n
	help
	  Enable the bpf() system call that allows to manipulate BPF programs
	  and maps via file descriptors.

config BPF_JIT
	bool "Enable BPF Just In Time compiler"
	depends on BPF
	depends on HAVE_CBPF_JIT || HAVE_EBPF_JIT
	select EXECMEM
	help
	  BPF programs are normally handled by a BPF interpreter. This option
	  allows the kernel to generate native code when a program is loaded
	  into the kernel. This will significantly speed-up processing of BPF
	  programs.

	  Note, an admin should enable this feature changing:
	  /proc/sys/net/core/bpf_jit_enable
	  /proc/sys/net/core/bpf_jit_harden   (optional)
	  /proc/sys/net/core/bpf_jit_kallsyms (optional)

config BPF_JIT_ALWAYS_ON
	bool "Permanently enable BPF JIT and remove BPF interpreter"
	depends on BPF_SYSCALL && HAVE_EBPF_JIT && BPF_JIT
	help
	  Enables BPF JIT and removes BPF interpreter to avoid speculative
	  execution of BPF instructions by the interpreter.

	  When CONFIG_BPF_JIT_ALWAYS_ON is enabled, /proc/sys/net/core/bpf_jit_enable
	  is permanently set to 1 and setting any other value than that will
	  return failure.

config BPF_JIT_DEFAULT_ON
	def_bool ARCH_WANT_DEFAULT_BPF_JIT || BPF_JIT_ALWAYS_ON
	depends on HAVE_EBPF_JIT && BPF_JIT

config BPF_UNPRIV_DEFAULT_OFF
	bool "Disable unprivileged BPF by default"
	default y
	depends on BPF_SYSCALL
	help
	  Disables unprivileged BPF by default by setting the corresponding
	  /proc/sys/kernel/unprivileged_bpf_disabled knob to 2. An admin can
	  still reenable it by setting it to 0 later on, or permanently
	  disable it by setting it to 1 (from which no other transition to
	  0 is possible anymore).

	  Unprivileged BPF could be used to exploit certain potential
	  speculative execution side-channel vulnerabilities on unmitigated
	  affected hardware.

	  If you are unsure how to answer this question, answer Y.

source "kernel/bpf/preload/Kconfig"

config BPF_LSM
	bool "Enable BPF LSM Instrumentation"
	depends on BPF_EVENTS
	depends on BPF_SYSCALL
	depends on SECURITY
	depends on BPF_JIT
	help
	  Enables instrumentation of the security hooks with BPF programs for
	  implementing dynamic MAC and Audit Policies.

	  If you are unsure how to answer this question, answer N.


config BPF_VERIFIER_REPLACE_TEST
	tristate "Test module for the BPF verifier dispatcher"
	depends on BPF_SYSCALL
	depends on m
	help
	  Build a small kernel module that exercises the BPF verifier
	  dispatcher API (register_bpf_verifier / unregister_bpf_verifier).
	  When loaded, the module replaces the built-in verifier with one
	  whose check() always returns -ENOSYS, making subsequent BPF
	  program loads fail until the module is unloaded.

	  Useful only for testing and demonstrating the dispatch and drain
	  semantics; not for production.  This is *not* a replacement
	  verifier -- a real loadable verifier is future work that
	  requires exporting many BPF-internal symbols.  See
	  Documentation/bpf/verifier_module.rst.

	  If unsure, say N.


config BPF_VERIFIER_REPLACEABLE
	tristate "Loadable replacement for the BPF verifier"
	depends on BPF_SYSCALL
	default y
	help
	  Build the BPF verifier (verifier.c and its private helpers) as a
	  unit that can be either compiled into vmlinux (=y, default) or
	  packaged as a loadable kernel module bpf_verifier.ko (=m).  When
	  =m, the kernel boots with the dispatcher in place but with no
	  active verifier; bpf(BPF_PROG_LOAD) returns -ENOENT until the
	  module is loaded.  This is useful for shipping a verifier bug
	  fix as a module without rebooting.

	  When unsure, say Y.

endmenu # "BPF subsystem"
```

## scripts/llvm-plugins/Kconfig
```kconfig
# SPDX-License-Identifier: GPL-2.0-only

menuconfig LLVM_PLUGINS
	bool "LLVM plugins"
	depends on CC_IS_CLANG
	depends on $(success,$(LLVM_CONFIG) --version)
	default y
	help
	  LLVM plugins add compiler passes to kernel and module builds.
	  Building them requires matching LLVM development headers and
	  llvm-config.

if LLVM_PLUGINS

endif
```
